## config/west.yml
```yaml
manifest:
  remotes:
    - name: zmkfirmware
      url-base: https://github.com/zmkfirmware
    - name: badjeff
      url-base: https://github.com/badjeff
    - name: george-norton
      url-base: https://github.com/george-norton
    - name: ianmarquez
      url-base: https://github.com/ianmarquez
  projects:
    - name: zmk
      remote: zmkfirmware
      revision: main
      import: app/west.yml
    - name: zmk-pmw3610-driver
      remote: badjeff
      revision: zmk-0.4
    - name: zmk-behavior-sensor-attr-cycle
      remote: george-norton
      revision: main
    - name: snake-module
      remote: ianmarquez
      revision: zephyr-4.1
  self:
    path: config
```
